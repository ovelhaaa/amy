## shared/smk_uart/Kconfig
```kconfig
menu "SMK inter-board control link"
    config SMK_LINK_ENABLED
        bool "Enable P4/S3 UART control link (requires confirmed wiring)"
        default n
    if SMK_LINK_ENABLED
        config SMK_LINK_UART
            int "UART peripheral (must not be the console UART)"
            range 0 2
            default 1
        config SMK_LINK_TX_GPIO
            int "Confirmed TX GPIO (-1 disables initialization)"
            range -1 54
            default -1
        config SMK_LINK_RX_GPIO
            int "Confirmed RX GPIO (-1 disables initialization)"
            range -1 54
            default -1
    endif
endmenu
```

## smk-p4/components/amy_runtime/Kconfig
```kconfig
menu "SMK-P4 AMY capacity"
config SMKP4_HARMONY
    bool "0.9 live scale and chord assist (experimental)"
    depends on SMKP4_UNIFIED_ENGINE && SMKP4_AMY_VOICES_8
    default n
config SMKP4_UNIFIED_ENGINE
    bool "0.8 reusable instruments (candidate; no physical qualification)"
    depends on SMKP4_STANDALONE
    default n
choice SMKP4_AMY_POLYPHONY
    prompt "Musical voices (fixed at boot)"
    depends on SMKP4_STANDALONE
    default SMKP4_AMY_VOICES_4
config SMKP4_AMY_VOICES_4
    bool "4 voices (qualified baseline)"
config SMKP4_AMY_VOICES_6
    bool "6 voices (candidate; hardware qualification required)"
config SMKP4_AMY_VOICES_8
    bool "8 voices (experimental; qualify 6 on hardware first)"
endchoice
config SMKP4_AMY_VOICES
    int
    default 8 if SMKP4_AMY_VOICES_8
    default 6 if SMKP4_AMY_VOICES_6
    default 4
endmenu
```

## smk-p4/components/audio_pcm5102/Kconfig
```kconfig
menu "SMK-P4 standalone PCM5102A bring-up"
config SMKP4_STANDALONE
    bool "Standalone bring-up application"
    default n
config SMKP4_PCM_WIRING_CONFIRMED
    bool "Operator confirmed JP1, DAC supply/straps and disconnected S3 UART"
    depends on SMKP4_STANDALONE && !SMK_LINK_ENABLED
    default n
    help
        Enables physical I2S output. Leave off until the wiring guide is checked.
config SMKP4_PCM_BCLK
    int "BCLK GPIO (candidate JP1-11)"
    range 50 52
    default 50
config SMKP4_PCM_WS
    int "WS GPIO (candidate JP1-9)"
    range 50 52
    default 51
config SMKP4_PCM_DATA
    int "DOUT GPIO (candidate JP1-7)"
    range 50 52
    default 52
config SMKP4_PCM_TEST_SEQUENCE
    bool "Audible test: silence / left / right / stereo / silence (2s each)"
    default n
config SMKP4_PCM_DIAGNOSTIC
    bool "Use diagnostic tone/silence instead of local AMY"
    depends on SMKP4_STANDALONE
    default n
    help
        When enabled, PCM_TEST_SEQUENCE selects silence or the channel sequence.
        Musical controls remain disabled. AMY is the normal standalone source.
config SMKP4_AMY_RAM_SELF_TEST
    bool "Run explicit AMY ROM/chord/release/Panic diagnostic in RAM at boot"
    depends on SMKP4_STANDALONE && !SMKP4_PCM_WIRING_CONFIRMED && !SMKP4_PCM_DIAGNOSTIC
    default n
    help
        Never initializes I2S. Logs PCM metrics for comparison with the same
        host diagnostic. Boot may take several seconds; not normal performance.
config SMKP4_PCM_TEST_HZ
    int "Test tone frequency Hz"
    range 20 20000
    default 440
endmenu
```

## smk-p4/components/usb_midi_host/Kconfig
```kconfig
menu "SMK-P4 native USB MIDI Host"
config SMKP4_USB_WIRING_CONFIRMED
    bool "Operator qualified USB connector, CC, VBUS and backfeed protection"
    depends on SMKP4_STANDALONE && !SMKP4_PCM_DIAGNOSTIC && !SMKP4_AMY_RAM_SELF_TEST
    default n
    help
        Electrical gate, independent of the PCM5102A gate. Never enable based
        only on a successful build. Does not enable a VBUS GPIO or supply 5V.
config SMKP4_USB_CONTROLLER
    int "Qualified USB controller (0=HS dedicated PHY, 1=FS OTG PHY)"
    depends on SMKP4_USB_WIRING_CONFIRMED
    range 0 1
    default 0
    help
        Confirm actual connector routing and PHY selection for the tested ES
        unit before enabling. Serial/JTAG is a different USB controller;
        sharing a physical connector can still preclude simultaneous use.
config SMKP4_USB_DESCRIPTOR_LOG
    bool "Dump bounded configuration descriptor bytes at enumeration"
    depends on SMKP4_USB_WIRING_CONFIRMED
    default n
config SMKP4_USB_MIDI_TRACE
    bool "Record bounded raw MIDI trace (main prints at most four packets per 5s)"
    depends on SMKP4_USB_WIRING_CONFIRMED
    default n
endmenu
```

## smk-p4/main/Kconfig.projbuild
```kconfig
menu "SMK-P4 presentation"
config SMKP4_UI_BLUEPRINT
    bool "Use Blueprint 1.1 with live Performance adapter"
    depends on SMKP4_STANDALONE && !SMKP4_PCM_DIAGNOSTIC
    default n
    select LV_FONT_MONTSERRAT_14
    select LV_FONT_MONTSERRAT_20
    select LV_FONT_MONTSERRAT_28
    help
        Reuses the existing UI task and LVGL display/touch. Legacy UI remains
        default until physical memory/audio integration gates pass.
config SMKP4_SOUND_LIBRARY
    bool "Opt-in 0.7 resident FM library candidate (128/135/138/142)"
    depends on SMKP4_STANDALONE
    default n
    help
        Four boot-resident banks; fixed musical polyphony. Requires independent
        memory/audio qualification. No dynamic patch loading or new effects.
endmenu

config SMKP4_FULL_FACTORY_LIBRARY
    bool "Qualified full Juno/DX7 factory catalog"
    depends on SMKP4_UNIFIED_ENGINE && SMKP4_HARMONY
    default n

config SMKP4_SOUND_EDITOR
    bool "Experimental live sound editor 0.11 and User Presets"
    depends on SMKP4_FULL_FACTORY_LIBRARY && SMKP4_UI_BLUEPRINT
    default n
```

## smk-p4/sdkconfig.defaults
```kconfig
CONFIG_ESPTOOLPY_FLASHSIZE_16MB=y
CONFIG_ESPTOOLPY_FLASHMODE_QIO=y
CONFIG_ESPTOOLPY_FLASHFREQ_80M=y
CONFIG_SPIRAM=y
CONFIG_SPIRAM_BOOT_INIT=y
CONFIG_SPIRAM_USE_MALLOC=y
CONFIG_SPIRAM_SPEED_200M=y
CONFIG_ESP_DEFAULT_CPU_FREQ_MHZ_360=y
CONFIG_PARTITION_TABLE_CUSTOM=y
CONFIG_PARTITION_TABLE_CUSTOM_FILENAME="partitions.csv"
CONFIG_ESP_CONSOLE_USB_SERIAL_JTAG=y
CONFIG_ESP_MAIN_TASK_STACK_SIZE=24576
CONFIG_LOG_DEFAULT_LEVEL_INFO=y
CONFIG_LV_COLOR_DEPTH_16=y
CONFIG_LV_MEM_SIZE_KILOBYTES=128
CONFIG_LV_FONT_MONTSERRAT_20=y
CONFIG_LV_FONT_MONTSERRAT_28=y
CONFIG_LV_USE_SYSMON=n
# CONFIG_LV_BUILD_EXAMPLES is not set
```

## smk-p4/sdkconfig.defaults.standalone
```kconfig
CONFIG_SMKP4_STANDALONE=y
# CONFIG_SMK_LINK_ENABLED is not set
# CONFIG_SMKP4_PCM_WIRING_CONFIRMED is not set
# CONFIG_SMKP4_PCM_TEST_SEQUENCE is not set
CONFIG_SMKP4_PCM_BCLK=50
CONFIG_SMKP4_PCM_WS=51
CONFIG_SMKP4_PCM_DATA=52
CONFIG_SMKP4_PCM_TEST_HZ=440

# CONFIG_SMKP4_PCM_DIAGNOSTIC is not set
# CONFIG_SMKP4_AMY_RAM_SELF_TEST is not set
```

## smk-p4/ui-preview/sdkconfig.defaults
```kconfig
CONFIG_IDF_TARGET="esp32p4"
CONFIG_ESPTOOLPY_FLASHSIZE_16MB=y
CONFIG_ESPTOOLPY_FLASHMODE_QIO=y
CONFIG_ESPTOOLPY_FLASHFREQ_80M=y
CONFIG_PARTITION_TABLE_CUSTOM=y
CONFIG_PARTITION_TABLE_CUSTOM_FILENAME="partitions.csv"
CONFIG_SPIRAM=y
CONFIG_SPIRAM_SPEED_200M=y
CONFIG_SPIRAM_BOOT_INIT=y
CONFIG_SPIRAM_USE_MALLOC=y
CONFIG_SPIRAM_MALLOC_ALWAYSINTERNAL=16384
CONFIG_SPIRAM_MALLOC_RESERVE_INTERNAL=65536
CONFIG_ESP_DEFAULT_CPU_FREQ_MHZ_360=y
CONFIG_FREERTOS_HZ=1000
CONFIG_ESP_MAIN_TASK_STACK_SIZE=24576
CONFIG_ESP_TASK_WDT_EN=y
CONFIG_ESP_TASK_WDT_TIMEOUT_S=5
CONFIG_COMPILER_OPTIMIZATION_PERF=y
CONFIG_LV_COLOR_DEPTH_16=y
CONFIG_LV_MEM_SIZE_KILOBYTES=128
CONFIG_LV_DEF_REFR_PERIOD=16
CONFIG_LV_FONT_MONTSERRAT_12=y
CONFIG_LV_FONT_MONTSERRAT_14=y
CONFIG_LV_FONT_MONTSERRAT_16=y
CONFIG_LV_FONT_MONTSERRAT_18=y
CONFIG_LV_FONT_MONTSERRAT_20=y
CONFIG_LV_FONT_MONTSERRAT_24=y
CONFIG_LV_FONT_MONTSERRAT_28=y
CONFIG_LV_FONT_MONTSERRAT_32=y
CONFIG_LV_USE_LOG=n
CONFIG_LV_USE_PERF_MONITOR=n
CONFIG_LV_USE_MEM_MONITOR=n
CONFIG_LV_USE_CLIB_MALLOC=n
CONFIG_LV_USE_BUILTIN_MALLOC=y
```

## smk-s3/components/amy_engine/Kconfig
```kconfig
menu "AMY Synthesizer Configuration"
    config SMKS3_AMY_MAX_OSCS
        int "Maximum number of oscillators"
        default 120
        range 32 250
        help
            Maximum number of concurrent oscillators in AMY engine.

    choice SMKS3_AMY_BLOCK_SIZE
        prompt "AMY Block Size"
        default SMKS3_AMY_BLOCK_SIZE_256
        help
            Audio block size for AMY engine.

        config SMKS3_AMY_BLOCK_SIZE_128
            bool "128 samples"
        config SMKS3_AMY_BLOCK_SIZE_256
            bool "256 samples"
    endchoice
endmenu
```

## smk-s3/main/Kconfig.projbuild
```kconfig
menu "SMK-S3 board configuration"

    choice SMKS3_DISPLAY_PROFILE
        prompt "Display profile"
        default SMKS3_DISPLAY_PROFILE_WIDE_284X76
        help
            Select the logical panel geometry. The existing 284x76 panel remains
            the default. The 240x240 profile is opt-in until its exact module,
            offsets, orientation, color inversion and backlight polarity are
            confirmed on hardware.

        config SMKS3_DISPLAY_PROFILE_WIDE_284X76
            bool "2.25 inch 284x76 ST7789 widescreen"

        config SMKS3_DISPLAY_PROFILE_SQUARE_240X240
            bool "1.54 inch 240x240 ST7789 square (experimental)"
    endchoice

    if SMKS3_DISPLAY_PROFILE_SQUARE_240X240

        config SMKS3_DISPLAY_SQUARE_X_OFFSET
            int "Square panel X offset"
            range 0 320
            default 0
            help
                Controller GRAM offset. Zero is a non-final placeholder; use the
                value specified by the exact panel module.

        config SMKS3_DISPLAY_SQUARE_Y_OFFSET
            int "Square panel Y offset"
            range 0 320
            default 0
            help
                Controller GRAM offset. Zero is a non-final placeholder; use the
                value specified by the exact panel module.

        config SMKS3_DISPLAY_SQUARE_SWAP_XY
            bool "Swap square panel X/Y axes"
            default n

        config SMKS3_DISPLAY_SQUARE_MIRROR_X
            bool "Mirror square panel X axis"
            default n

        config SMKS3_DISPLAY_SQUARE_MIRROR_Y
            bool "Mirror square panel Y axis"
            default n

        config SMKS3_DISPLAY_SQUARE_INVERT_COLOR
            bool "Invert square panel colors"
            default y
            help
                The validated 1.54 inch 240x240 module requires the ST7789
                display-inversion command for the intended palette. Disable
                this option for modules whose panel glass uses normal mode.

        config SMKS3_DISPLAY_SQUARE_BL_ACTIVE_LOW
            bool "Square panel backlight is active-low"
            default n

    endif

endmenu
```

## smk-s3/sdkconfig.defaults
```kconfig
CONFIG_IDF_TARGET="esp32s3"

# CPU
CONFIG_ESP_DEFAULT_CPU_FREQ_MHZ_240=y
CONFIG_ESP_DEFAULT_CPU_FREQ_MHZ=240

# Memory (16MB Flash, 8MB PSRAM)
CONFIG_ESPTOOLPY_FLASHSIZE_16MB=y
CONFIG_ESPTOOLPY_FLASHFREQ_80M=y
CONFIG_ESPTOOLPY_FLASHMODE_QIO=y

CONFIG_ESP32S3_SPIRAM_SUPPORT=y
CONFIG_SPIRAM=y
CONFIG_SPIRAM_MODE_OCT=y
CONFIG_SPIRAM_SPEED_80M=y
CONFIG_SPIRAM_BOOT_INIT=y
CONFIG_SPIRAM_IGNORE_NOTFOUND=n
CONFIG_SPIRAM_USE_MALLOC=y

# Main Task Stack Size
CONFIG_ESP_MAIN_TASK_STACK_SIZE=16384

# FreeRTOS
CONFIG_FREERTOS_HZ=1000

# USB Host
CONFIG_USB_HOST_CONTROL_TRANSFER_MAX_SIZE=256

# Console via UART0 (Ponte CH340 / CP2102 nos pinos GPIO43/44)
# Permite manter o Serial Monitor/CLI aberto no computador permanentemente
# enquanto a porta USB Nativa opera exclusivamente como USB MIDI Host!
CONFIG_ESP_CONSOLE_UART_DEFAULT=y
CONFIG_ESP_CONSOLE_UART_NUM=0
CONFIG_ESP_CONSOLE_UART_BAUDRATE=115200

# Performance optimization
CONFIG_COMPILER_OPTIMIZATION_PERF=y
CONFIG_COMPILER_CXX_EXCEPTIONS=n
CONFIG_COMPILER_CXX_RTTI=n

# Partition table
CONFIG_PARTITION_TABLE_CUSTOM=y
CONFIG_PARTITION_TABLE_CUSTOM_FILENAME="partitions.csv"
CONFIG_PARTITION_TABLE_FILENAME="partitions.csv"
CONFIG_PARTITION_TABLE_OFFSET=0x8000

# Brownout detector
CONFIG_ESP_BROWNOUT_DET=y
CONFIG_ESP_BROWNOUT_DET_LVL_SEL_2=y

# Stack overflow detection
CONFIG_ESP_SYSTEM_HW_STACK_GUARD=y
CONFIG_FREERTOS_WATCHPOINT_END_OF_STACK=y
CONFIG_FREERTOS_CHECK_STACKOVERFLOW_CANARY=y

# Watchdog
CONFIG_ESP_TASK_WDT=y
CONFIG_ESP_TASK_WDT_PANIC=n
CONFIG_ESP_TASK_WDT_TIMEOUT_S=10
```
